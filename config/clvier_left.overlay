#include "clvier.dtsi"

&kscan0 {
    // 【列（COL）のピンアサイン定義】
    // ここに並べた順に、システム側で自動的に Col0, Col1, Col2... と割り当てられます。
    col-gpios
        = <&gpio1 15 GPIO_ACTIVE_HIGH> // 1番目＝Col0 (11番ピン: P1.15)
          <&gpio1 11 GPIO_ACTIVE_HIGH> // 2番目＝Col1 (7番ピン:  P1.11)
          <&gpio1 14 GPIO_ACTIVE_HIGH> // 3番目＝Col2 (10番ピン: P1.14)
          <&gpio1 13 GPIO_ACTIVE_HIGH> // 4番目＝Col3 (9番ピン:  P1.13)
          <&gpio0 28 GPIO_ACTIVE_HIGH> // 5番目＝Col4 (3番ピン:  P0.28)
        ;

    // 【行（ROW）のピンアサイン定義】
    // ここに並べた順に、システム側で自動的に Row0, Row1, Row2... と割り当てられます。
    row-gpios
        = <&gpio0  3 (GPIO_ACTIVE_HIGH | GPIO_PULL_DOWN)> // 1番目＝Row0 (2番ピン:  P0.03)
          <&gpio0 29 (GPIO_ACTIVE_HIGH | GPIO_PULL_DOWN)> // 2番目＝Row1 (4番ピン:  P0.29)
          <&gpio0 10 (GPIO_ACTIVE_HIGH | GPIO_PULL_DOWN)> // 3番目＝Row2 (22番ピン: P0.10)
          <&gpio1 12 (GPIO_ACTIVE_HIGH | GPIO_PULL_DOWN)> // 4番目＝Row3 (8番ピン:  P1.12)
        ;
