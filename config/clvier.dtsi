#include <dt-bindings/zmk/matrix_transform.h>

/ {
    chosen {
        zmk,matrix-transform = &default_transform;
    };

    default_transform: keymap_transform_0 {
        compatible = "zmk,matrix-transform";
        columns = <11>; // 左5列 + 右6列 = 合計11列
        rows = <4>;     // 行数 (4行)

        // 物理キーとマトリクスの対応表（左5列・右6列の構成）
        // 左側：RC(行, 0)〜RC(行, 4) | 右側：RC(行, 5)〜RC(行, 10)
        bindings = <
            RC(0,0) RC(0,1) RC(0,2) RC(0,3) RC(0,4)    RC(0,5) RC(0,6) RC(0,7) RC(0,8) RC(0,9) RC(0,10)
            RC(1,0) RC(1,1) RC(1,2) RC(1,3) RC(1,4)    RC(1,5) RC(1,6) RC(1,7) RC(1,8) RC(1,9) RC(1,10)
            RC(2,0) RC(2,1) RC(2,2) RC(2,3) RC(2,4)    RC(2,5) RC(2,6) RC(2,7) RC(2,8) RC(2,9) RC(2,10)
                            RC(3,2) RC(3,3) RC(3,4)    RC(3,5) RC(3,6) RC(3,7) RC(3,8)
        >;
    };

    // 左右共通のマトリクス構造定義（ピン番号は左右それぞれのファイルで指定）
    kscan0: kscan {
        compatible = "zmk,kscan-gpio-matrix";
        wakeup-source;
        diode-direction = "col2row"; // ダイオードの向き：列(Col)から行(Row)
    };
};
